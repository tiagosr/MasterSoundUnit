/*
 * Master Sound Unit
 * FM module for the Sega Master System
 * implemented using the MAME YM2413 core
 * along with a (toggleable) PSG emulator to override the builtin one
 * (c) 2017 tiagosr
 */

// TODO list:
// [~] YM2413 core
// [ ] PSG core
// [x] bus logic
// 
// cool stuff for the future maybe perhaps:
// [ ] VRC7 core
// [ ] YM2149/AY core
//

struct OPLL_SLOT {
  uint32_t ar;  // attack rate:  AR << 2
  uint32_t dr;  // decay rate:   DR << 2
  uint32_t rr;  // release rate: RR << 2
  uint8_t  KSR; // key scale rate
  uint8_t  ksl; // key scale level
  uint8_t  ksr; // key scale rate(2): kcode>>KSR
  uint8_t  mul; // multiplier: mul_tab[ML]

  // Phase Generator
  uint32_t phase;      // frequency counter
  uint32_t freq;       // frequency counter step
  uint8_t  fb_shift;   // feedback shift value
  int32_t  op1_out[2]; // slot1 output for feedback

  // Envelope Generator
  uint8_t  eg_type; // percussive/nonpercussive mode
  uint8_t  state;   // phase type
  uint32_t TL;      // total level: TL << 2
  int32_t  TLL;     // adjusted TL
  int32_t  volume;  // envelope counter
  uint32_t sl;      // sustain level: sl_tab[SL]

  uint8_t  eg_sh_dp;  // (dump state)
  uint8_t  eg_sel_dp; // (dump state)
  uint8_t  eg_sh_ar;  // (attack state)
  uint8_t  eg_sel_ar; // (attack state)
  uint8_t  eg_sh_dr;  // (decay state)
  uint8_t  eg_sel_dr; // (decay state)
  uint8_t  eg_sh_rr;  // (release state for non-percussive mode)
  uint8_t  eg_sel_rr; // (release state for non-percussive mode)
  uint8_t  eg_sh_rs;  // (release state for percussive mode)
  uint8_t  eg_sel_rs; // (release state for percussive mode)

  byte     key;  // 0 = key off, >0 = key on

  // LFO
  uint32_t AMmask; // LFO amplitude modulation enable mask
  uint8_t  vib;    // LFO amplitude modulation (vibrato) enable flag

  // waveform select
  uint16_t wavetable;
};

struct OPLL_CH {
  OPLL_SLOT SLOT[2];
  
  // phase generator state
  uint32_t block_fnum; // block + fnum
  uint32_t fc;         // Frequency increment base
  uint32_t ksl_base;   // KeyScaleLevel Base step
  uint8_t  kcode;      // key code (for key scaling)
  uint8_t  sus;        // sustain on/off (release speed in percussive mode)
};

#define RATE_STEPS 8
#define SIN_BITS 10
#define SIN_LEN (1<<SIN_BITS)
#define SIN_MASK (SIN_LEN-1)

#define TL_RES_LEN 256

#define TL_TAB_LEN (11*2*(TL_RES_LEN))

#define LFO_AM_TAB_ELEMENTS 210

#define FREQ_SH 16 /* 16.16 fixed point Freq calc */
#define EG_SH   16 /* 16.16 fixed point EG timing calc */
#define LFO_SH  24 /*  8.24 fixed point LFO calc */

#define FREQ_MASK (((uint32_t)1<<FREQ_SH)-1)

#define ENV_BITS 10
#define ENV_LEN  (1<<ENV_BITS)
#define ENV_STEP (128.0/ENV_LEN)

#define ENV_QUIET (TL_TAB_LEN>>5)

#define MAX_ATT_INDEX   ((1<<(ENV_BITS-2))-1) /*255*/
#define MIN_ATT_INDEX (0)
/* register number to channel number , slot offset */
#define SLOT1 0
#define SLOT2 1

/* Envelope Generator phases */

#define EG_DMP          5
#define EG_ATT          4
#define EG_DEC          3
#define EG_SUS          2
#define EG_REL          1
#define EG_OFF          0

const uint8_t ksl_shift[4] = {31, 2, 1, 0};

#define SC(db) (uint16_t)((db)*(1.0/ENV_STEP))
const uint32_t sl_tab[16]   = {
  SC( 0),SC( 1),SC( 2),SC(3 ),SC(4 ),SC(5 ),SC(6 ),SC( 7),
  SC( 8),SC( 9),SC(10),SC(11),SC(12),SC(13),SC(14),SC(15)
};
#undef SC

#define ML 2
const uint8_t  mul_tab[16]  = {
  /* 1/2, 1, 2, 3, 4, 5, 6, 7, 8, 9,10,10,12,12,15,15 */
  ML/2, 1*ML, 2*ML, 3*ML, 4*ML, 5*ML, 6*ML, 7*ML,
  8*ML, 9*ML,10*ML,10*ML,12*ML,12*ML,15*ML,15*ML
};
#undef ML

const uint8_t eg_inc[15*RATE_STEPS] PROGMEM = {
  /* 0 */ 0,1, 0,1, 0,1, 0,1, /* rates 00..12 0 (increment by 0 or 1) */
  /* 1 */ 0,1, 0,1, 1,1, 0,1, /* rates 00..12 1 */
  /* 2 */ 0,1, 1,1, 0,1, 1,1, /* rates 00..12 2 */
  /* 3 */ 0,1, 1,1, 1,1, 1,1, /* rates 00..12 3 */

  /* 4 */ 1,1, 1,1, 1,1, 1,1, /* rate 13 0 (increment by 1) */
  /* 5 */ 1,1, 1,2, 1,1, 1,2, /* rate 13 1 */
  /* 6 */ 1,2, 1,2, 1,2, 1,2, /* rate 13 2 */
  /* 7 */ 1,2, 2,2, 1,2, 2,2, /* rate 13 3 */

  /* 8 */ 2,2, 2,2, 2,2, 2,2, /* rate 14 0 (increment by 2) */
  /* 9 */ 2,2, 2,4, 2,2, 2,4, /* rate 14 1 */
  /*10 */ 2,4, 2,4, 2,4, 2,4, /* rate 14 2 */
  /*11 */ 2,4, 4,4, 2,4, 4,4, /* rate 14 3 */

  /*12 */ 4,4, 4,4, 4,4, 4,4, /* rates 15 0, 15 1, 15 2, 15 3 (increment by 4) */
  /*13 */ 8,8, 8,8, 8,8, 8,8, /* rates 15 2, 15 3 for attack */
  /*14 */ 0,0, 0,0, 0,0, 0,0, /* infinity rates for attack and decay(s) */  
};

#define O(a) ((a)*RATE_STEPS)
const uint8_t eg_rate_select[16+64+16] PROGMEM = {
  /* 16 infinite time rates */
  O(14),O(14),O(14),O(14),O(14),O(14),O(14),O(14),
  O(14),O(14),O(14),O(14),O(14),O(14),O(14),O(14),

  /* rates 00-12 */
  O( 0),O( 1),O( 2),O( 3),
  O( 0),O( 1),O( 2),O( 3),
  O( 0),O( 1),O( 2),O( 3),
  O( 0),O( 1),O( 2),O( 3),
  O( 0),O( 1),O( 2),O( 3),
  O( 0),O( 1),O( 2),O( 3),
  O( 0),O( 1),O( 2),O( 3),
  O( 0),O( 1),O( 2),O( 3),
  O( 0),O( 1),O( 2),O( 3),
  O( 0),O( 1),O( 2),O( 3),
  O( 0),O( 1),O( 2),O( 3),
  O( 0),O( 1),O( 2),O( 3),
  O( 0),O( 1),O( 2),O( 3),

  /* rate 13 */
  O( 4),O( 5),O( 6),O( 7),

  /* rate 14 */
  O( 8),O( 9),O(10),O(11),

  /* rate 15 */
  O(12),O(12),O(12),O(12),

  /* 16 dummy rates (same as 15 3) */
  O(12),O(12),O(12),O(12),O(12),O(12),O(12),O(12),
  O(12),O(12),O(12),O(12),O(12),O(12),O(12),O(12),
};
#undef O

#define O(a) ((a)*1)
const uint8_t eg_rate_shift[16+64+16] PROGMEM = {
  /* 16 infinite time rates */
  O(0),O(0),O(0),O(0),O(0),O(0),O(0),O(0),
  O(0),O(0),O(0),O(0),O(0),O(0),O(0),O(0),

  /* rates 00-12 */
  O(13),O(13),O(13),O(13),
  O(12),O(12),O(12),O(12),
  O(11),O(11),O(11),O(11),
  O(10),O(10),O(10),O(10),
  O( 9),O( 9),O( 9),O( 9),
  O( 8),O( 8),O( 8),O( 8),
  O( 7),O( 7),O( 7),O( 7),
  O( 6),O( 6),O( 6),O( 6),
  O( 5),O( 5),O( 5),O( 5),
  O( 4),O( 4),O( 4),O( 4),
  O( 3),O( 3),O( 3),O( 3),
  O( 2),O( 2),O( 2),O( 2),
  O( 1),O( 1),O( 1),O( 1),

  /* rate 13 */
  O( 0),O( 0),O( 0),O( 0),

  /* rate 14 */
  O( 0),O( 0),O( 0),O( 0),

  /* rate 15 */
  O( 0),O( 0),O( 0),O( 0),

  /* 16 dummy rates (same as 15 3) */
  O( 0),O( 0),O( 0),O( 0),O( 0),O( 0),O( 0),O( 0),
  O( 0),O( 0),O( 0),O( 0),O( 0),O( 0),O( 0),O( 0),
};
#undef O

const uint8_t lfo_am_table[LFO_AM_TAB_ELEMENTS] PROGMEM = {
  0,0,0,0,0,0,0,
  1,1,1,1,
  2,2,2,2,
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  1,1,1,1
};
const int8_t  lfo_pm_table[8*8] PROGMEM = {
  /* FNUM2/FNUM = 0 00xxxxxx (0x0000) */
  0, 0, 0, 0, 0, 0, 0, 0,

  /* FNUM2/FNUM = 0 01xxxxxx (0x0040) */
  1, 0, 0, 0,-1, 0, 0, 0,

  /* FNUM2/FNUM = 0 10xxxxxx (0x0080) */
  2, 1, 0,-1,-2,-1, 0, 1,

  /* FNUM2/FNUM = 0 11xxxxxx (0x00C0) */
  3, 1, 0,-1,-3,-1, 0, 1,

  /* FNUM2/FNUM = 1 00xxxxxx (0x0100) */
  4, 2, 0,-2,-4,-2, 0, 2,

  /* FNUM2/FNUM = 1 01xxxxxx (0x0140) */
  5, 2, 0,-2,-5,-2, 0, 2,

  /* FNUM2/FNUM = 1 10xxxxxx (0x0180) */
  6, 3, 0,-3,-6,-3, 0, 3,

  /* FNUM2/FNUM = 1 11xxxxxx (0x01C0) */
  7, 3, 0,-3,-7,-3, 0, 3,
};

const int16_t tl_tab[TL_TAB_LEN] PROGMEM = {
    2042,-2042,2037,-2037,2031,-2031,2026,-2026,2020,-2020,2015,-2015,2010,-2010,2004,-2004,1999,-1999,1993,-1993,1988,-1988,1983,-1983,1977,-1977,1972,-1972,1966,-1966,1961,-1961,
    1956,-1956,1951,-1951,1945,-1945,1940,-1940,1935,-1935,1930,-1930,1924,-1924,1919,-1919,1914,-1914,1909,-1909,1904,-1904,1898,-1898,1893,-1893,1888,-1888,1883,-1883,1878,-1878,
    1873,-1873,1868,-1868,1863,-1863,1858,-1858,1853,-1853,1848,-1848,1843,-1843,1838,-1838,1833,-1833,1828,-1828,1823,-1823,1818,-1818,1813,-1813,1808,-1808,1803,-1803,1798,-1798,
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    133,-133,133,-133,133,-133,132,-132,132,-132,132,-132,131,-131,131,-131,130,-130,130,-130,130,-130,129,-129,129,-129,129,-129,128,-128,128,-128};
OPLL_CH P_CH[9]; // 9 Channels
uint8_t instvol_r[0]; // instrument/volume (or volume/volume in perc. mode)

uint32_t eg_cnt;           // global envelope generator counter
uint32_t eg_timer;         // global envelope generator counter at chipclock/72
uint32_t eg_timer_add;     // step of eg_timer
uint32_t eg_timer_overflow; // EG overflow (every 1 sample)

uint8_t  rhythm; // rhythm mode

// LFO
uint32_t LFO_AM;
int32_t  LFO_PM;
uint32_t lfo_am_cnt;
uint32_t lfo_am_inc;
uint32_t lfo_pm_cnt;
uint32_t lfo_pm_inc;

uint32_t noise_rng;  // 23-bit LFSR for noise
uint32_t noise_p;    // current noise 'phase'
uint32_t noise_f;    // current noise period

/*
 * 0 - user instrument
 * 1-15 - fixed instruments
 * 16 - bass drum settings
 * 17-18 - other percussion instruments
 */

uint8_t  inst_tab[19][8];
const uint8_t default_inst_tab[19][8] PROGMEM = {
/* MULT  MULT modTL DcDmFb AR/DR AR/DR SL/RR SL/RR */
/*   0     1     2     3     4     5     6    7    */
  {0x49, 0x4c, 0x4c, 0x12, 0x00, 0x00, 0x00, 0x00 },  //0

  {0x61, 0x61, 0x1e, 0x17, 0xf0, 0x78, 0x00, 0x17 },  //1
  {0x13, 0x41, 0x1e, 0x0d, 0xd7, 0xf7, 0x13, 0x13 },  //2
  {0x13, 0x01, 0x99, 0x04, 0xf2, 0xf4, 0x11, 0x23 },  //3
  {0x21, 0x61, 0x1b, 0x07, 0xaf, 0x64, 0x40, 0x27 },  //4

//{0x22, 0x21, 0x1e, 0x09, 0xf0, 0x76, 0x08, 0x28 },    //5
  {0x22, 0x21, 0x1e, 0x06, 0xf0, 0x75, 0x08, 0x18 },  //5

//{0x31, 0x22, 0x16, 0x09, 0x90, 0x7f, 0x00, 0x08 },    //6
  {0x31, 0x22, 0x16, 0x05, 0x90, 0x71, 0x00, 0x13 },  //6

  {0x21, 0x61, 0x1d, 0x07, 0x82, 0x80, 0x10, 0x17 },  //7
  {0x23, 0x21, 0x2d, 0x16, 0xc0, 0x70, 0x07, 0x07 },  //8
  {0x61, 0x61, 0x1b, 0x06, 0x64, 0x65, 0x10, 0x17 },  //9

//{0x61, 0x61, 0x0c, 0x08, 0x85, 0xa0, 0x79, 0x07 },    //A
  {0x61, 0x61, 0x0c, 0x18, 0x85, 0xf0, 0x70, 0x07 },  //A

  {0x23, 0x01, 0x07, 0x11, 0xf0, 0xa4, 0x00, 0x22 },  //B
  {0x97, 0xc1, 0x24, 0x07, 0xff, 0xf8, 0x22, 0x12 },  //C

//{0x61, 0x10, 0x0c, 0x08, 0xf2, 0xc4, 0x40, 0xc8 },    //D
  {0x61, 0x10, 0x0c, 0x05, 0xf2, 0xf4, 0x40, 0x44 },  //D

  {0x01, 0x01, 0x55, 0x03, 0xf3, 0x92, 0xf3, 0xf3 },  //E
  {0x61, 0x41, 0x89, 0x03, 0xf1, 0xf4, 0xf0, 0x13 },  //F

/* drum instruments definitions */
/* MULTI MULTI modTL  xxx  AR/DR AR/DR SL/RR SL/RR */
/*   0     1     2     3     4     5     6    7    */
  {0x01, 0x01, 0x16, 0x00, 0xfd, 0xf8, 0x2f, 0x6d },/* BD(multi verified, modTL verified, mod env - verified(close), carr. env verifed) */
  {0x01, 0x01, 0x00, 0x00, 0xd8, 0xd8, 0xf9, 0xf8 },/* HH(multi verified), SD(multi not used) */
  {0x05, 0x01, 0x00, 0x00, 0xf8, 0xba, 0x49, 0x55 },/* TOM(multi,env verified), TOP CYM(multi verified, env verified) */
  
};


/*
 * The following tables are generated by the following python program:

"""
Table generator for Master FM
"""
from math import log, log10, pow, sin
from itertools import chain

PI = 3.14159265358979323846

def DV(f):
    #return float(f/(0.1875/1.0)) # 3dB/octave to 6dB/octave
    return int(f / (0.1875 / 1.0))  # 3dB/octave to 6dB/octave

SIN_BITS = 10
SIN_LEN = (1<<SIN_BITS)
ENV_BITS = 10
ENV_LEN = (1<<ENV_BITS)
ENV_STEP = (128.0/ENV_LEN)
TL_RES_LEN = 256
TL_TAB_LEN = (11*2*(TL_RES_LEN))
FREQ_SH = 16

def ym_sin(x):
    m = sin(((x * 2) + 1) * PI / SIN_LEN)
    o = 8.0*log(1.0/abs(m))/log(2.0)
    o = o / (ENV_STEP/4)
    n = int(2.0*o)
    if (n&1):
        n = (n>>1)+1;
    else:
        n = n>>1
    return n*2 + (0 if m>=0 else 1)

sin_tab = [ym_sin(x) for x in range(SIN_LEN)]
sin_tab.extend([TL_TAB_LEN if x & (1<<(SIN_BITS-1)) else ym_sin(x) for x in range(SIN_LEN)])

fn_tab = [i * (64 << (FREQ_SH-10)) for i in range(1024)]

def tl_entry(x):
    n = int((1<<16)/pow(2, (x+1) * (ENV_STEP/4.0) / 8.0)) >> 4

    if n&1:
        n = (n>>1)+1
    else:
        n = n>>1
    return n, -n

tl_tab = list(chain(* (tl_entry(x) for x in range(1024))))

ksl_tab = [DV(x) for x in
           [
               # Octave 0
               0.000, 0.000, 0.000, 0.000,
               0.000, 0.000, 0.000, 0.000,
               0.000, 0.000, 0.000, 0.000,
               0.000, 0.000, 0.000, 0.000,
               # Octave 1
               0.000, 0.000, 0.000, 0.000,
               0.000, 0.000, 0.000, 0.000,
               0.000, 0.750, 1.125, 1.500,
               1.875, 2.250, 2.625, 3.000,
               # Octave 2
               0.000, 0.000, 0.000, 0.000,
               0.000, 1.125, 1.875, 2.625,
               3.000, 3.750, 4.125, 4.500,
               4.875, 5.250, 5.625, 6.000,
               # Octave 3
               0.000, 0.000, 0.000, 1.875,
               3.000, 4.125, 4.875, 5.625,
               6.000, 6.750, 7.125, 7.500,
               7.875, 8.250, 8.625, 9.000,
               # Octave 4
               0.000, 0.000, 3.000, 4.875,
               6.000, 7.125, 7.875, 8.625,
               9.000, 9.750,10.125,10.500,
               10.875,11.250,11.625,12.000,
               # Octave 5
               0.000, 3.000, 6.000, 7.875,
               9.000,10.125,10.875,11.625,
               12.000,12.750,13.125,13.500,
               13.875,14.250,14.625,15.000,
               # Octave 6
               0.000, 6.000, 9.000,10.875,
               12.000,13.125,13.875,14.625,
               15.000,15.750,16.125,16.500,
               16.875,17.250,17.625,18.000,
               # Octave 7
               0.000, 9.000,12.000,13.875,
               15.000,16.125,16.875,17.625,
               18.000,18.750,19.125,19.500,
               19.875,20.250,20.625,21.000
    ]]


def get_table_sizes(table):
    if isinstance(table, list):
        inner = get_table_sizes(table[0])
        if inner:
            return [len(table), ]+inner
        return [len(table), ]
    return None

def emit_table_contents(table, indent=4):
    return "{{{}}}".format(
        ",".join("\n"+(" "*indent)+emit_table_contents(item, indent=indent+4) if isinstance(item, list)
                 else "\n"+(" "*indent)+str(item) if (index > 0 and index % 32 == 0) else
                 str(item)
                 for index, item in enumerate(table))
    )
def emit_nested_table(type, tableName, table):
    return """const {type} {tableName}{sizes} PROGMEM = {contents};""".format(
        type = type,
        tableName = tableName,
        sizes = "".join("[{}]".format(size) for size in get_table_sizes(table)),
        contents = emit_table_contents(table)
    )


print("""
{sin_tab}

{fn_tab}

{ksl_tab}

{tl_tab}
""".format(
    sin_tab=emit_nested_table("uint16_t", "sin_tab", sin_tab),
    fn_tab =emit_nested_table("uint32_t", "fn_tab", fn_tab),
    ksl_tab=emit_nested_table("uint8_t", "ksl_tab", ksl_tab),
    tl_tab=emit_nested_table("int16_t", "tl_tab", tl_tab)
))
 
 */

const uint16_t sin_tab[2048] PROGMEM = {4274,3462,3086,2838,2652,2504,2380,2274,2182,2100,2026,1958,1898,1840,1788,1738,1692,1650,1608,1570,1534,1498,1464,1434,1402,1374,1344,1318,1292,1266,1242,1218,
    1196,1174,1152,1132,1112,1092,1072,1054,1036,1018,1002,984,968,952,936,922,906,892,878,864,850,836,822,810,798,784,772,760,750,738,726,716,
    704,694,682,672,662,652,642,632,622,614,604,594,586,578,568,560,552,542,534,526,518,510,502,496,488,480,472,466,458,452,444,438,
    430,424,418,410,404,398,392,386,380,374,368,362,356,350,344,338,334,328,322,318,312,306,302,296,292,286,282,276,272,268,262,258,
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    5632,5632,5632,5632,5632,5632,5632,5632,5632,5632,5632,5632,5632,5632,5632,5632,5632,5632,5632,5632,5632,5632,5632,5632,5632,5632,5632,5632,5632,5632,5632,5632};

const uint8_t ksl_tab[128] PROGMEM = {0,0,0,0,0,0,0,0,0,0,0,0,0,0,0,0,0,0,0,0,0,0,0,0,0,4,6,8,10,12,14,16,
    0,0,0,0,0,6,10,14,16,20,22,24,26,28,30,32,0,0,0,10,16,22,26,30,32,36,38,40,42,44,46,48,
    0,0,16,26,32,38,42,46,48,52,54,56,58,60,62,64,0,16,32,42,48,54,58,62,64,68,70,72,74,76,78,80,
    0,32,48,58,64,70,74,78,80,84,86,88,90,92,94,96,0,48,64,74,80,86,90,94,96,100,102,104,106,108,110,112};


// fnumber->increment counter
const uint32_t fn_tab[1024] PROGMEM = {0,4096,8192,12288,16384,20480,24576,28672,32768,36864,40960,45056,49152,53248,57344,61440,65536,69632,73728,77824,81920,86016,90112,94208,98304,102400,106496,110592,114688,118784,122880,126976,
    131072,135168,139264,143360,147456,151552,155648,159744,163840,167936,172032,176128,180224,184320,188416,192512,196608,200704,204800,208896,212992,217088,221184,225280,229376,233472,237568,241664,245760,249856,253952,258048,
    262144,266240,270336,274432,278528,282624,286720,290816,294912,299008,303104,307200,311296,315392,319488,323584,327680,331776,335872,339968,344064,348160,352256,356352,360448,364544,368640,372736,376832,380928,385024,389120,
    393216,397312,401408,405504,409600,413696,417792,421888,425984,430080,434176,438272,442368,446464,450560,454656,458752,462848,466944,471040,475136,479232,483328,487424,491520,495616,499712,503808,507904,512000,516096,520192,
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    4063232,4067328,4071424,4075520,4079616,4083712,4087808,4091904,4096000,4100096,4104192,4108288,4112384,4116480,4120576,4124672,4128768,4132864,4136960,4141056,4145152,4149248,4153344,4157440,4161536,4165632,4169728,4173824,4177920,4182016,4186112,4190208};

uint8_t  address; // address register

int16_t output[2]; // 9-bit, actually

#define SLOT7_1 (&P_CH[7].SLOT[SLOT1])
#define SLOT7_2 (&P_CH[7].SLOT[SLOT2])
#define SLOT8_1 (&P_CH[8].SLOT[SLOT1])
#define SLOT8_2 (&P_CH[8].SLOT[SLOT2])

inline int limit(int val, int _max, int _min) {
  return min(max(val, _min), _max);
}

void advance_lfo() {
  lfo_am_cnt += lfo_am_inc;
  if (lfo_am_cnt >= ((uint32_t)LFO_AM_TAB_ELEMENTS<<LFO_SH)) {
    lfo_am_cnt -= ((uint32_t)LFO_AM_TAB_ELEMENTS<<LFO_SH);
  }
  LFO_AM = lfo_am_table[lfo_am_cnt >> LFO_SH] >> 1;
  lfo_pm_cnt += lfo_pm_inc;
  LFO_PM = (lfo_pm_cnt>>LFO_SH) & 7;
}

// advance to the next sample
void advance() {
  OPLL_CH *CH;
  OPLL_SLOT *op;
  byte i;
  eg_timer += eg_timer_add;

  while (eg_timer >= eg_timer_overflow) {
    eg_timer -= eg_timer_overflow;
    eg_cnt++;
    for (i = 0; i < 9*2; i++) {
      CH = &P_CH[i/2];
      op = &CH->SLOT[i&1];
      switch (op->state) {
      case EG_DMP: // dump phase
        if (!(eg_cnt &((1<<op->eg_sh_dp)-1))) {
          op->volume += eg_inc[op->eg_sel_dp + ((eg_cnt>>op->eg_sh_dp)&7)];
          if (op->volume >= MAX_ATT_INDEX) {
            op->volume = MAX_ATT_INDEX;
            op->state = EG_ATT;
            op->phase = 0;
          }
        }
        break;
      case EG_ATT: // attack phase
        if (!(eg_cnt & ((1<<op->eg_sh_ar)-1))) {
          op->volume += (~op->volume*(eg_inc[op->eg_sel_ar + ((eg_cnt>>op->eg_sh_ar)&7)])) >>2;
          if (op->volume <= MIN_ATT_INDEX) {
            op->volume = MIN_ATT_INDEX;
            op->state = EG_DEC;
          }
        }
        break;
      case EG_DEC: // decay phase
        if (!(eg_cnt & ((1<<op->eg_sh_dr)-1))) {
          op->volume += eg_inc[op->eg_sel_dr + ((eg_cnt>>op->eg_sh_dr)&7)];
          if (op->volume >= op->sl) {
            op->state = EG_SUS;
          }
        }
        break;
      case EG_SUS: // sustain phase
        if(op->eg_type) {
          // non-percussive mode, do nothing
        } else {
          if (!(eg_cnt & ((1<<op->eg_sh_rr)-1))) {
            op->volume += eg_inc[op->eg_sel_rr + ((eg_cnt>>op->eg_sh_rr)&7)];
            if (op->volume >= MAX_ATT_INDEX) {
              op->volume = MAX_ATT_INDEX;
            }
          }
        }
        break;
      case EG_REL: // release phase
        if ((i&1) || ((rhythm & 0x20)&&(i>=12))) { // exclude modulators
          if (op->eg_type) {
            if (CH->sus) {
              if (!(eg_cnt & ((1<<op->eg_sh_rs)-1))) {
                op->volume += eg_inc[op->eg_sel_rs + ((eg_cnt>>op->eg_sh_rs)&7)];
                if (op->volume >= MAX_ATT_INDEX) {
                  op->volume = MAX_ATT_INDEX;
                  op->state = EG_OFF;
                }
              }
            } else {
              if(!(eg_cnt & ((1<<op->eg_sh_rr)-1))) {
                op->volume += eg_inc[op->eg_sel_rr + ((eg_cnt>>op->eg_sh_rr)&7)];
                if (op->volume >= MAX_ATT_INDEX) {
                  op->volume = MAX_ATT_INDEX;
                  op->state = EG_OFF;
                }
              }
            }
          } else {
            if (!(eg_cnt & ((1<<op->eg_sh_rs)-1))) {
              op->volume += eg_inc[op->eg_sel_rs + ((eg_cnt>>op->eg_sh_rs)&7)];
              if (op->volume >= MAX_ATT_INDEX) {
                op->volume = MAX_ATT_INDEX;
                op->state = EG_OFF;
              }
            }
          }
          break;
        default:
          break;
        }
      }
    }
    for (i=0; i<9*2; i++) {
      CH = &P_CH[i/2];
      op = &CH->SLOT[i&1];
      if (op->vib) {
        uint8_t block;

        uint16_t fnum_lfo = 8*((CH->block_fnum&0x01c0) >> 6);
        uint16_t block_fnum = CH->block_fnum*2;
        int8_t lfo_fn_table_index_offset = lfo_pm_table[LFO_PM + fnum_lfo];
        if (lfo_fn_table_index_offset) {
          block_fnum += lfo_fn_table_index_offset;
          block = (block_fnum&0x1c00)>>10;
          op->phase += (fn_tab[block_fnum&0x03ff] >> (7-block)) * op->mul;
        } else {
          op->phase += op->freq;
        }
      } else {
        op->phase += op->freq;
      }
    }

    noise_p += noise_f;
    i = noise_p >> FREQ_SH;
    noise_p &= FREQ_MASK;

    while(i) {
      if (noise_rng & 1) noise_rng ^= 0x800302;
      noise_rng >> 1;
      i--;
    }
  }
}

int16_t op_calc(uint32_t phase, uint32_t env, int32_t pm, uint16_t wave_tab) {
  uint32_t p = (env<<5) + sin_tab[wave_tab+((((int32_t)((phase& ~FREQ_MASK)+(pm<<17))) >> FREQ_SH ) & SIN_MASK) ];
  if (p >= TL_TAB_LEN) return 0;
  return tl_tab[p];
}

int16_t op_calc1(uint32_t phase, uint32_t env, int32_t pm, uint16_t wave_tab) {
  int32_t i = (phase&~FREQ_MASK)+pm;
  uint32_t p = (env<<5) + sin_tab[wave_tab + ((i>>FREQ_SH) & SIN_MASK)];
  if (p >= TL_TAB_LEN) return 0;
  return tl_tab[p];
}

#define volume_calc(OP) ((OP)->TLL + ((uint32_t)(OP)->volume) + (LFO_AM & (OP)->AMmask))

void chan_calc(OPLL_CH *CH) {
  OPLL_SLOT *SLOT;
  uint32_t env;
  int16_t  out;
  int32_t  phase_modulation;

  SLOT = &CH->SLOT[SLOT1];
  env = volume_calc(SLOT);
  out = SLOT->op1_out[0] + SLOT->op1_out[1];

  phase_modulation = SLOT->op1_out[0] = SLOT->op1_out[1];

  SLOT->op1_out[1] = 0;

  if (env < ENV_QUIET) {
    if (!SLOT->fb_shift) out = 0;
    SLOT->op1_out[1] = op_calc1(SLOT->phase, env, (out<<SLOT->fb_shift), SLOT->wavetable);
  }

  SLOT++;
  env = volume_calc(SLOT);
  if (env < ENV_QUIET) {
    output[0] += op_calc(SLOT->phase, env, phase_modulation, SLOT->wavetable);
  }
}

void rhythm_calc(OPLL_CH *CH, byte noise) {
  // SLOT 1
  OPLL_SLOT *SLOT = &CH[6].SLOT[SLOT1];
  int16_t out = SLOT->op1_out[0] + SLOT->op1_out[1];
  uint32_t env = volume_calc(SLOT);
  int32_t phase_modulation = SLOT->op1_out[0] = SLOT->op1_out[1];
  SLOT->op1_out[1] = 0;

  if (env < ENV_QUIET) {
    if (!SLOT->fb_shift) out = 0;
    SLOT->op1_out[1] = op_calc1(SLOT->phase, env, (out << SLOT->fb_shift), SLOT->wavetable);
  }

  // SLOT 2
  SLOT++;
  env = volume_calc(SLOT);
  if (env < ENV_QUIET) {
    output[1] += op_calc(SLOT->phase, env, phase_modulation, SLOT->wavetable);
  }

  // hi-hat
  env = volume_calc(SLOT7_1);
  if (env < ENV_QUIET) {
    byte bit7 = ((SLOT7_1->phase>>FREQ_SH)>>7)&1;
    byte bit3 = ((SLOT7_1->phase>>FREQ_SH)>>3)&1;
    byte bit2 = ((SLOT7_1->phase>>FREQ_SH)>>2)&1;
    byte res1 = (bit2 ^ bit7) | bit3;

    uint32_t phase = res1 ? (0x200|0xd0>>2) : 0xd0;
    byte res2 = ((((SLOT8_2->phase>>FREQ_SH)>>5)&1) | (((SLOT8_2->phase>>FREQ_SH)>>5)&1));

    if (res2) phase = 0x200|(0xd0>>2);
    if (phase & 0x200) {
      if (noise) phase = 0x200|(0xd0>>2);
    } else {
      if (noise) phase = 0xd0>>2;
    }
    output[1] += op_calc(phase<<FREQ_SH, env, 0, SLOT7_1->wavetable) * 2;
  }

  // snare drum
  env = volume_calc(SLOT7_2);
  if (env<ENV_QUIET) {
    byte bit8 = ((SLOT7_1->phase>>FREQ_SH)>>8)&1;
    uint32_t phase = bit8 ? 0x200 : 0x100;
    if (noise) phase ^= 0x100;
    output[1] += op_calc(phase<<FREQ_SH, env, 0, SLOT7_2->wavetable) * 2;
  }

  // tom tom
  env = volume_calc(SLOT8_1);
  if (env < ENV_QUIET) {
    output[1] += op_calc(SLOT8_1->phase, env, 0, SLOT8_1->wavetable) * 2;
  }

  // top cymbal
  env = volume_calc(SLOT8_2);
  if (env < ENV_QUIET) {
    byte bit7 = ((SLOT7_1->phase>>FREQ_SH)>>7)&1;
    byte bit3 = ((SLOT7_1->phase>>FREQ_SH)>>3)&1;
    byte bit2 = ((SLOT7_1->phase>>FREQ_SH)>>2)&1;
    byte res1 = (bit2 ^ bit7) | bit3;

    uint32_t phase = res1 ? 0x300 : 0x100;
    byte res2 = ((((SLOT8_2->phase>>FREQ_SH)>>5)&1) | (((SLOT8_2->phase>>FREQ_SH)>>5)&1));

    if (res2) phase = 0x300;
    output[1] += op_calc(phase<<FREQ_SH, env, 0, SLOT8_2->wavetable) * 2;
  }
}

void key_on(OPLL_SLOT *SLOT, byte key_set) {
  if (!SLOT->key) {
    // don't restart Phase Generator
    // set phase to Dump
    SLOT->state = EG_DMP;
  }
  SLOT->key |= key_set;
}

void key_off(OPLL_SLOT *SLOT, byte key_clr) {
  if (SLOT->key) {
    SLOT->key &= key_clr;
    if (!SLOT->key) {
      if (SLOT->state > EG_REL) {
        SLOT->state = EG_REL;
      }
    }
  }
}

void calc_fcslot(OPLL_CH *CH, OPLL_SLOT *SLOT) {
  int32_t ksr = CH->kcode >> SLOT->KSR;
  uint32_t SLOT_rs, SLOT_dp;
  SLOT->freq = CH->fc * SLOT->mul;

  if (SLOT->ksr != ksr) {
    SLOT->ksr = ksr;

    // calculate envelope generator rates
    if ((SLOT->ar + SLOT->ksr) < 16+62) {
      SLOT->eg_sh_ar  = eg_rate_shift [SLOT->ar + SLOT->ksr];
      SLOT->eg_sel_ar = eg_rate_select[SLOT->ar + SLOT->ksr];
    } else {
      SLOT->eg_sh_ar  = 0;
      SLOT->eg_sel_ar = 13*RATE_STEPS;
    }
    SLOT->eg_sh_dr  = eg_rate_shift [SLOT->dr + SLOT->ksr];
    SLOT->eg_sel_dr = eg_rate_select[SLOT->dr + SLOT->ksr];
    SLOT->eg_sh_rr  = eg_rate_shift [SLOT->rr + SLOT->ksr];
    SLOT->eg_sel_rr = eg_rate_select[SLOT->rr + SLOT->ksr];
  }

  if (CH->sus) {
    SLOT_rs = 16 + (5<<2);
  } else {
    SLOT_rs = 16 + (7<<2);
  }

  SLOT->eg_sh_rs  = eg_rate_shift [SLOT_rs + SLOT->ksr];
  SLOT->eg_sel_rs = eg_rate_select[SLOT_rs + SLOT->ksr];

  SLOT_dp = 16 + (13<<2);
  SLOT->eg_sh_dp  = eg_rate_shift [SLOT_dp + SLOT->ksr];
  SLOT->eg_sel_dp = eg_rate_select[SLOT_dp + SLOT->ksr];
}

void set_mul(byte slot, byte v) {
  OPLL_CH *CH = &P_CH[slot/2];
  OPLL_SLOT *SLOT = &CH->SLOT[slot&1];

  SLOT->mul = mul_tab[v&0x0f];
  SLOT->KSR = (v&0x10) ? 0 : 2;
  SLOT->eg_type = (v&0x20);
  SLOT->vib = (v&0x40);
  SLOT->AMmask = (v&0x80)?~0:0;
  calc_fcslot(CH, SLOT);
}

void set_ksl_tl(byte chan, byte v) {
  OPLL_CH *CH = &P_CH[chan];
  OPLL_SLOT *SLOT = &CH->SLOT[SLOT1];
  SLOT->ksl = ksl_shift[v >> 6];
  SLOT->TL  = (v&0x3f)<<(ENV_BITS-2-7);
  SLOT->TLL = SLOT->TL + (CH->ksl_base>>SLOT->ksl);
}

void set_ksl_wave_fb(byte chan, byte v) {
  OPLL_CH *CH = &P_CH[chan];
  OPLL_SLOT *SLOT = &CH->SLOT[SLOT1];
  SLOT->wavetable = ((v&0x08)>>3)*SIN_LEN;
  SLOT->fb_shift  = (v&7)? (v&7)+8 : 0;

  SLOT = &CH->SLOT[SLOT2];
  SLOT->ksl = ksl_shift[v>>6];
  SLOT->TLL = SLOT->TL + (CH->ksl_base>>SLOT->ksl);

  SLOT->wavetable = ((v&0x10)>>4)*SIN_LEN;
}

void set_ar_dr(byte slot, byte v) {
  OPLL_CH *CH = &P_CH[slot/2];
  OPLL_SLOT *SLOT = &CH->SLOT[slot&1];

  SLOT->ar = (v&0xf0) ? 16 + ((v&0xf0) >> 2) : 0;

  if ((SLOT->ar + SLOT->ksr) < 16+62) {
    SLOT->eg_sh_ar  = eg_rate_shift [SLOT->ar + SLOT->ksr];
    SLOT->eg_sel_ar = eg_rate_select[SLOT->ar + SLOT->ksr];
  } else {
    SLOT->eg_sh_ar = 0;
    SLOT->eg_sel_ar = 13*RATE_STEPS;
  }

  SLOT->dr = (v&0x0f)? 16 + ((v&0x0f) << 2) : 0;
  SLOT->eg_sh_dr  = eg_rate_shift [SLOT->dr + SLOT->ksr];
  SLOT->eg_sel_dr = eg_rate_select[SLOT->dr + SLOT->ksr];
}

void set_sl_rr(byte slot, byte v) {
  OPLL_CH *CH = &P_CH[slot/2];
  OPLL_SLOT *SLOT = &CH->SLOT[slot&1];

  SLOT->sl = sl_tab[v >> 4];
  
  SLOT->rr = (v&0x0f)? 16 + ((v&0x0f) << 2) : 0;
  SLOT->eg_sh_rr  = eg_rate_shift [SLOT->rr + SLOT->ksr];
  SLOT->eg_sel_rr = eg_rate_select[SLOT->rr + SLOT->ksr];
}

void load_instrument(byte chan, byte* inst) {
  byte slot = chan*2;
  set_mul         (slot,   inst[0]);
  set_mul         (slot+1, inst[1]);
  set_ksl_tl      (chan,   inst[2]);
  set_ksl_wave_fb (chan,   inst[3]);
  set_ar_dr       (slot,   inst[4]);
  set_ar_dr       (slot+1, inst[5]);
  set_sl_rr       (slot,   inst[6]);
  set_sl_rr       (slot+1, inst[7]);
}

void update_instrument_zero(byte r) {
  uint8_t* inst = &inst_tab[0][0];
  byte chan, chan_max = 9;

  if (rhythm & 0x20) chan_max = 6;

  switch (r) {
  case 0:
    for(chan=0; chan<chan_max; chan++) {  
      if ((instvol_r[chan]&0xf0)==0) {
        set_mul(chan*2, inst[0]);
      }
    }
    break;
  case 1:
    for(chan=0; chan<chan_max; chan++) {  
      if ((instvol_r[chan]&0xf0)==0) {
        set_mul(chan*2+1, inst[1]);
      }
    }
    break;
  case 2:
    for(chan=0; chan<chan_max; chan++) {  
      if ((instvol_r[chan]&0xf0)==0) {
        set_ksl_tl(chan, inst[2]);
      }
    }
    break;
  case 3:
    for(chan=0; chan<chan_max; chan++) {  
      if ((instvol_r[chan]&0xf0)==0) {
        set_ksl_wave_fb(chan, inst[3]);
      }
    }
    break;
  case 4:
    for(chan=0; chan<chan_max; chan++) {  
      if ((instvol_r[chan]&0xf0)==0) {
        set_ar_dr(chan*2, inst[4]);
      }
    }
    break;
  case 5:
    for(chan=0; chan<chan_max; chan++) {  
      if ((instvol_r[chan]&0xf0)==0) {
        set_ar_dr(chan*2, inst[5]);
      }
    }
    break;
  case 6:
    for(chan=0; chan<chan_max; chan++) {  
      if ((instvol_r[chan]&0xf0)==0) {
        set_sl_rr(chan*2, inst[6]);
      }
    }
    break;
  case 7:
    for(chan=0; chan<chan_max; chan++) {  
      if ((instvol_r[chan]&0xf0)==0) {
        set_sl_rr(chan*2, inst[7]);
      }
    }
    break;
  }
}

void write_reg(byte r, byte v) {
  OPLL_CH *CH;
  OPLL_SLOT *SLOT;

  uint8_t *inst;
  byte chan, slot;

  switch(r&0xf0) {
    case 0x00: // 00-0f: control
    {
      switch(r&0x0f) {
      case 0x00:
      case 0x01:
      case 0x02:
      case 0x03:
      case 0x04:
      case 0x05:
      case 0x06:
      case 0x07:
        inst_tab[0][r&7] = v;
        update_instrument_zero(r&7);
      break;
      case 0x0e:
      {
        if (v&0x20) {
          if ((rhythm&0x20)==0) {
            // rhythm off->on
            load_instrument(6, inst_tab[16]);
            load_instrument(7, inst_tab[17]);
            CH = &P_CH[7];
            SLOT = &CH->SLOT[SLOT1];
            SLOT->TL = ((instvol_r[7]&0xf0)>>2) << (ENV_BITS-2-7);
            SLOT->TLL = SLOT->TL + (CH->ksl_base>>SLOT->ksl);
            load_instrument(8, inst_tab[18]);
            CH = &P_CH[8];
            SLOT = &CH->SLOT[SLOT1];
            SLOT->TL = ((instvol_r[8]&0xf0)>>2) << (ENV_BITS-2-7);
            SLOT->TLL = SLOT->TL + (CH->ksl_base>>SLOT->ksl);
          }
          // bass drum key on/off
          if (v&0x10) {
            key_on(&P_CH[6].SLOT[SLOT1], 2);
            key_on(&P_CH[6].SLOT[SLOT2], 2);
          } else {
            key_off(&P_CH[6].SLOT[SLOT1], ~2);
            key_off(&P_CH[6].SLOT[SLOT2], ~2);
          }
          // hi-hat
          if (v&0x01) {
            key_on (&P_CH[7].SLOT[SLOT1], 2);
          } else {
            key_off(&P_CH[7].SLOT[SLOT1],~2);
          }
          // snare-drum
          if (v&0x08) {
            key_on (&P_CH[7].SLOT[SLOT2], 2);
          } else {
            key_off(&P_CH[7].SLOT[SLOT2],~2);
          }
          // tom tom
          if (v&0x04) {
            key_on (&P_CH[8].SLOT[SLOT1], 2);
          } else {
            key_off(&P_CH[8].SLOT[SLOT1],~2);
          }
          // top-cymbal
          if (v&0x01) {
            key_on (&P_CH[8].SLOT[SLOT2], 2);
          } else {
            key_off(&P_CH[8].SLOT[SLOT2],~2);
          }
        } else {
          if (rhythm&0x20) {
            // rhythm on->off
            load_instrument(6, &inst_tab[instvol_r[6]>>4][0]);
            load_instrument(7, &inst_tab[instvol_r[7]>>4][0]);
            load_instrument(8, &inst_tab[instvol_r[8]>>4][0]);
          }
          key_off(&P_CH[6].SLOT[SLOT1], ~2);
          key_off(&P_CH[6].SLOT[SLOT2], ~2);
          key_off(&P_CH[7].SLOT[SLOT1],~2);
          key_off(&P_CH[7].SLOT[SLOT2],~2);
          key_off(&P_CH[8].SLOT[SLOT1],~2);
          key_off(&P_CH[8].SLOT[SLOT2],~2);
        }
        rhythm = v&0x3f;
      }
      break;
      }
    }
    break;
    
    case 0x10:
    case 0x20:
    {
      uint16_t block_fnum;
      chan = r&0x0f;
      if (chan >= 9) chan -= 9;

      CH = &P_CH[chan];
      if (r&0x10) {
        block_fnum= (CH->block_fnum&0x0f00) | v;
      } else {
        block_fnum = ((v&0x0f)<<8) | (CH->block_fnum&0xff);

        if (v&0x10) {
          key_on(&CH->SLOT[SLOT1], 1);
          key_on(&CH->SLOT[SLOT2], 1);
        } else {
          key_off(&CH->SLOT[SLOT1],~1);
          key_off(&CH->SLOT[SLOT2],~1);
        }
        
        CH->sus = v & 0x20;
      }
      if (CH->block_fnum != block_fnum) {
        uint8_t block;
        CH->block_fnum = block_fnum;

        CH->kcode = (block_fnum&0x0f00)>>8;
        CH->ksl_base = static_cast<uint32_t>(ksl_tab[block_fnum>>5]);

        block_fnum = block_fnum*2;
        block = (block_fnum&0x1c00) >> 10;
        CH->fc = fn_tab[block_fnum&0x03ff] >> (7-block);

        CH->SLOT[SLOT1].TLL = CH->SLOT[SLOT1].TL + (CH->ksl_base>>CH->SLOT[SLOT1].ksl);
        CH->SLOT[SLOT2].TLL = CH->SLOT[SLOT2].TL + (CH->ksl_base>>CH->SLOT[SLOT2].ksl);

        calc_fcslot(CH, &CH->SLOT[SLOT1]);
        calc_fcslot(CH, &CH->SLOT[SLOT2]);
      }
    }
    break;
    
    case 0x30: // inst 4 MSBs, vol 4 LSBs
    {
      uint8_t old_instvol;
      chan = r&0x0f;

      if (chan >= 9) chan -= 9;

      old_instvol = instvol_r[chan];
      instvol_r[chan] = v;

      CH = &P_CH[chan];
      SLOT = &CH->SLOT[SLOT2];
      SLOT->TL = ((v&0x0f)<<2)<<(ENV_BITS-2-8);
      SLOT->TLL = SLOT->TL + (CH->ksl_base>>SLOT->ksl);

      if ((chan>=6) && (rhythm&0x20)) {
        // in rhythm mode
        if (chan >= 7) {
          // only for channels 7 and 8
          SLOT = &CH->SLOT[SLOT1];
          SLOT->TL = ((instvol_r[chan]&0xf0)>>2)<<(ENV_BITS-2-7);
          SLOT->TLL = SLOT->TL + (CH->ksl_base>>SLOT->ksl);
        }
      } else {
        if ((old_instvol&0xf0) == (v&0xf0)) return;
        load_instrument(chan, inst_tab[instvol_r[chan]>>4]);
      }
    }
    break;
    
    default:
    break;
  }
}

void device_reset() {
  eg_timer = 0;
  eg_cnt = 0;
  noise_rng = 1;

  for (byte i = 0; i < 19; i++) {
    for (byte c = 0; c < 8; c++) {
      inst_tab[i][c] = default_inst_tab[i][c];
    }
  }

  write_reg(0x0f, 0);
  for (byte i = 0x3f; i>= 0x10; i--) {
    write_reg(i, 0x00);
  }
  
  for (byte c = 0; c < 9; c++) {
    P_CH[c].SLOT[0].wavetable = 0;
    P_CH[c].SLOT[0].state     = EG_OFF;
    P_CH[c].SLOT[0].volume    = MAX_ATT_INDEX;
    P_CH[c].SLOT[1].wavetable = 0;
    P_CH[c].SLOT[1].state     = EG_OFF;
    P_CH[c].SLOT[1].volume    = MAX_ATT_INDEX;
  }
}

volatile byte reg_latch;
volatile byte reg_control;

#if defined (__AVR_ATmega328P__)
const byte ioPin = 2;
const byte wrPin = 3;

inline void just_set_data_read() {
  DDRD &= B00001111; // PD4-PD7 -> D4-D7
  DDRB &= B11000011; // PB2-PB5 -> D0-D3

}
inline byte set_data_read() {
  just_set_data_read();
  return (PIND&0xf0)|((PINB>>2)&0xf);
}

inline void set_data_write(byte b) {
  DDRD |= B11110000;
  DDRB |= B00111100;
  PORTD = (PORTD&0xf) | (b&0xf0);
  PORTB = (PORTB&B11000011) | ((b&0xf)<<2);
}

void set_pins() {
  just_set_data_read();
  pinMode(wrPin, INPUT);
  pinMode(ioPin, INPUT_PULLUP);
  DDRB &= 0x03; // PB0-PB1 -> A0-A1
  DDRC &= 0xf0; // PC0-PC3 -> A4-A7
  attachInterrupt(digitalPinToInterrupt(ioPin), io_interrupt, CHANGE);
}
void io_interrupt() {
  if (PIND&4) {
    // a port access ended - better to set the ports to input here
    just_set_data_read();
    return;
  }
  byte addr = PINC & 0xf;
  switch(addr) {
  case 0xf:
    {
      if (PIND&8) { // write
        switch(PINB & 3) {
        case 0:
          reg_latch = set_data_read();
          break;
        case 1:
          write_reg(reg_latch, set_data_read());
          break;
        case 2:
          reg_control = set_data_read() & 3;
          break;
        }
      } else {
        if ((PINB&3)== 2) {
          set_data_write(reg_control);
        }
      }
    }
    break;
  default:
    return;
  }
}
#else
void io_interrupt() {
  // do nothing
}
#endif


void setup() {
  
  set_pins();
  
  lfo_am_inc = ((uint32_t)1<<LFO_SH) / 64;
  lfo_pm_inc = ((uint32_t)1<<LFO_SH) / 1024;
  noise_f = (uint32_t)((uint32_t)1 << FREQ_SH);
  eg_timer_add = (uint32_t)((uint32_t)1 << EG_SH);
  eg_timer_overflow = (uint32_t)((uint32_t)1 << EG_SH);
  device_reset();
}

void loop() {
  output[0] = 0;
  output[1] = 0;
  advance_lfo();
  for(byte c = 0; c < 6; c++) {
    chan_calc(&P_CH[c]);
  }
  if (!(rhythm & 0x20)) {
    chan_calc(&P_CH[6]);
    chan_calc(&P_CH[7]);
    chan_calc(&P_CH[8]);
  } else {
    rhythm_calc(&P_CH[0], noise_rng & 1);
  }
  advance();
}
